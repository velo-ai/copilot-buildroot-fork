## package/kmsxx/Config.in
```kconfig
config BR2_PACKAGE_KMSXX
	bool "kms++"
	depends on BR2_TOOLCHAIN_GCC_AT_LEAST_4_8
	depends on BR2_TOOLCHAIN_HEADERS_AT_LEAST_4_11 # linux/dma-buf.h
	depends on BR2_INSTALL_LIBSTDCPP
	depends on BR2_TOOLCHAIN_HAS_THREADS # libdrm
	depends on BR2_USE_WCHAR # fmt
	select BR2_PACKAGE_FMT
	select BR2_PACKAGE_LIBDRM
	########################################################################
	# Copilot specific
	# 
	# To build python bindings we need pybind11 but the pybind subproject
	# for kms is so old that it fails with Python 3.11. So build pybind
	# so that it gets installed to staging so the old pybind subproject
	# isn't used.
	########################################################################
	select BR2_PACKAGE_HOST_PYTHON3
	select BR2_PACKAGE_PYTHON_PYBIND
	########################################################################
	# End Copilot specific
	########################################################################
	help
	  libkms++ is a C++11 library for kernel mode setting.

	  Also included are simple test tools for KMS.

	  https://github.com/tomba/kmsxx

if BR2_PACKAGE_KMSXX

config BR2_PACKAGE_KMSXX_INSTALL_TESTS
	bool "Install test programs"
	help
	  This option allows to install the kmsxx test programs.

endif

comment "kms++ needs a toolchain w/ threads, C++, gcc >= 4.8, headers >= 4.11, wchar"
	depends on !BR2_TOOLCHAIN_HAS_THREADS || !BR2_INSTALL_LIBSTDCPP || \
		!BR2_TOOLCHAIN_GCC_AT_LEAST_4_8 || !BR2_TOOLCHAIN_HEADERS_AT_LEAST_4_11 \
		|| !BR2_USE_WCHAR
```
